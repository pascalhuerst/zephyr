## boards/arm/nucleo_f767zi/Kconfig.defconfig
```kconfig
# Kconfig - STM32F767ZI Nucleo board configuration
#
# Copyright (c) 2019 Pascal Huerst
#
# SPDX-License-Identifier: Apache-2.0
#

if BOARD_NUCLEO_F767ZI

config BOARD
	default "nucleo_f767zi"

if UART_CONSOLE

config UART_2
	default y

endif # UART_CONSOLE

if SERIAL

config UART_2
	default y

endif # SERIAL

if I2C

config I2C_1
	default y

endif # I2C

if SPI

config SPI_2
	default y

config SPI_STM32_INTERRUPT
	default y

endif # SPI

if PWM

config PWM_STM32_2
	default n

endif # PWM

if NETWORKING

config USB
	default y

config USB_DEVICE_STACK
	default y

config USB_DEVICE_NETWORK_EEM
	default n

endif # NETWORKING

endif # BOARD_NUCLEO_F767ZI
```
